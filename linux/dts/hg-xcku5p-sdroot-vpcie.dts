// SPDX-License-Identifier: MIT
/*
 * SD-root boot with the HDMI frame buffer and the logical PCIe root complex (-vpcie bitstream, KVPCIE=1 kernel): kernel messages go to the screen (console=tty0) and to the UART (the last console, /dev/console).
 * Needs KHDMI=1, KVPCIE=1 and a -vpcie bitstream (hdmi_out included).
 */
/dts-v1/;
#include "hg-xcku5p.dtsi"
#include "hg-xcku5p-hdmi.dtsi"
#include "hg-xcku5p-vpcie.dtsi"

/ {
	chosen {
		bootargs = "console=tty0 console=ttyUL0,230400 earlycon=sbi root=/dev/mmcblk0p1 rootwait ro rootfstype=ext4";
	};
};
