// SPDX-License-Identifier: MIT
/* Profiling variant of hg-xcku5p-sdroot.dts: kernel CPU-tick profile (read with readprofile; build with KPROFILE=1). */
/dts-v1/;
#include "hg-xcku5p.dtsi"

/ {
	chosen {
		bootargs = "console=ttyUL0,230400 earlycon=sbi root=/dev/mmcblk0p1 rootwait ro rootfstype=ext4 profile=2";
	};
};
