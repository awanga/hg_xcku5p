// SPDX-License-Identifier: MIT
/* Debug variant of hg-xcku5p-sdroot.dts: kernel messages also go to a UDP listener on the LAN (netconsole), for use when the
 * serial console stops. Set the target address to the host that runs `python3 tools/netcon_listen.py`. */
/dts-v1/;
#include "hg-xcku5p.dtsi"

/ {
	chosen {
		bootargs = "console=ttyUL0,230400 earlycon=sbi root=/dev/mmcblk0p1 rootwait ro rootfstype=ext4 ignore_loglevel netconsole=6665@192.168.1.247/eth0,6666@192.168.1.167/";
	};
};
